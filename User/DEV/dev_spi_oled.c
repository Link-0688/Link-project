/**********************************************************
 * 文件名: dev_spi_oled.c
 * 日  期: 2026-07-31
 *
 * 功能说明:
 *   SSD1306 OLED 128x64 SPI 通用设备层驱动实现
 *   显存缓冲 (gram) + 统一刷新架构
 *   通过 DC 引脚区分命令/数据, CS 引脚做片选, RES 硬件复位
 *
 * 架构分层: APP → DEV (本层) → BSP (bsp_sw_spi) → HAL
 *
 * 关键设计:
 *   1. dev_oled_show_char 写入显存前先清空字符区域 (防重影)
 *   2. dev_oled_show_string 默认 8x16 字模, size=12 可选 6x8
 *   3. dev_oled_init 通过 RES 引脚硬件复位, 无需 I2C 地址扫描
 *   4. Bresenham 画线 / 中点画圆 / 矩形填充, 全部基于 gram 操作
 **********************************************************/

#include "dev_spi_oled.h"
#include "bsp_sw_spi.h"
#include "main.h"
#include <stdio.h>
#include "FreeRTOS.h"
#include "semphr.h"

/* ================================================================
 * 全局显存: 8 页 × 128 列, 共 1024 字节
 * g_u8_oled_gram[page][col] 的 bit(n) → 像素 (col, page*8 + n)
 * ================================================================*/
uint8_t g_u8_oled_gram[DEV_OLED_PAGES][DEV_OLED_WIDTH];

/* SPI 总线互斥锁：TaskUI 整页刷新与 TaskSys 熄屏/对比度命令并发访问软件 SPI，
 * 不加锁会导致 CS/DC 时序错乱 → 花屏/乱码 */
static SemaphoreHandle_t s_oled_mutex = NULL;

static void oled_spi_lock(void)
{
    if(s_oled_mutex != NULL)
    {
        xSemaphoreTake(s_oled_mutex, portMAX_DELAY);
    }
}

static void oled_spi_unlock(void)
{
    if(s_oled_mutex != NULL)
    {
        xSemaphoreGive(s_oled_mutex);
    }
}

/* ================================================================
 * 6×8 ASCII 字模 (空格 ' ' ~ '~', 95 字符)
 * 横向取模, 每字符 6 字节, 每字节对应一列自上而下 8 像素
 * ================================================================*/
static const uint8_t s_u8_f6x8[95][6] = {
    { 0x00, 0x00, 0x00, 0x00, 0x00, 0x00 }, /*   (0) */
    { 0x00, 0x00, 0x5F, 0x00, 0x00, 0x00 }, /* ! (1) */
    { 0x00, 0x07, 0x00, 0x07, 0x00, 0x00 }, /* " (2) */
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    { 0x02, 0x01, 0x02, 0x04, 0x02, 0x00 }, /* ~ (94) */
};

/* ================================================================
 * 8×16 ASCII 字模 (空格 ' ' ~ '~', 95 字符)
 * 横向取模, 每字符 16 字节:
 *   前 8 字节 → 上半部 (列 0~7, 上部 8 行)
 *   后 8 字节 → 下半部 (列 0~7, 下部 8 行)
 * 来源: 原 OLED_Font.c → OLED_F8x16 数组
 * ================================================================*/
static const uint8_t s_u8_f8x16[95][16] = {
    { 0x00,0x00,0x00,0x00,0x00,0x00,0x00,0x00,
      0x00,0x00,0x00,0x00,0x00,0x00,0x00,0x00 }, /*   0 */
    { 0x00,0x00,0x00,0xF8,0x00,0x00,0x00,0x00,
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      0x00,0x00,0x00,0x00,0x00,0x00,0x00,0x00 }, /* ~ 94 */
};

/* ================================================================
 * 内部函数: SPI 写命令 (单字节)
 * DC=0 → 命令模式, CS=0 使能, 发送 1 字节, CS=1 释放
 * ================================================================*/
static void dev_oled_write_cmd(uint8_t u8_cmd)
{
    bsp_sw_spi_dc_low();
    bsp_sw_spi_cs_low();
    bsp_sw_spi_write_byte(u8_cmd);
    bsp_sw_spi_cs_high();
    bsp_sw_spi_dc_high();
}

/* ================================================================
 * 内部函数: SPI 批量写数据
 * 一次 CS 使能周期内连续发送 len 字节
 * 用于显存刷新, 每页 128 字节合并传输
 * ================================================================*/
static void dev_oled_write_datas(const uint8_t *p_data, uint16_t u16_len)
{
    bsp_sw_spi_dc_high();
    bsp_sw_spi_cs_low();

    for (uint16_t i = 0U; i < u16_len; i++) {
        bsp_sw_spi_write_byte(p_data[i]);
    }

    bsp_sw_spi_cs_high();
}

/* ================================================================
 * 内部函数: 设置 OLED 光标 (页地址 + 列地址)
 * @param u8_page 页地址 0~7
 * @param u8_col  列地址 0~127
 * ================================================================*/
static void dev_oled_set_cursor(uint8_t u8_page, uint8_t u8_col)
{
    dev_oled_write_cmd((uint8_t)(0xB0 | u8_page));
    dev_oled_write_cmd((uint8_t)(0x10 | ((u8_col & 0xF0U) >> 4)));
    dev_oled_write_cmd((uint8_t)(0x00 | (u8_col & 0x0FU)));
}

/* ================================================================
 * 内部函数: 发送 SSD1306 标准初始化命令序列
 * SPI 模式, 与 I2C 版本使用相同的 SSD1306 命令集
 * ================================================================*/
static void dev_oled_send_init_sequence(void)
{
    dev_oled_write_cmd(0xAE); /* 关闭显示 */

    dev_oled_write_cmd(0xD5); /* 显示时钟分频比 */
    dev_oled_write_cmd(0x80);

    dev_oled_write_cmd(0xA8); /* 多路复用率 64 */
    dev_oled_write_cmd(0x3F);

    dev_oled_write_cmd(0xD3); /* 显示偏移 */
    dev_oled_write_cmd(0x00);

    dev_oled_write_cmd(0x40); /* 显示起始行 = 0 */

    dev_oled_write_cmd(0xA1); /* 段重映射 (左右正常) */

    dev_oled_write_cmd(0xC8); /* COM 扫描方向 (上下正常) */

    dev_oled_write_cmd(0xDA); /* COM 引脚硬件配置 */
    dev_oled_write_cmd(0x12);

    dev_oled_write_cmd(0x81); /* 对比度 */
    dev_oled_write_cmd(0xCF);

    dev_oled_write_cmd(0xD9); /* 预充电周期 */
    dev_oled_write_cmd(0xF1);

    dev_oled_write_cmd(0xDB); /* VCOMH 电压 */
    dev_oled_write_cmd(0x30);

    dev_oled_write_cmd(0xA4); /* 显示跟随 GDDRAM */
    dev_oled_write_cmd(0xA6); /* 正常显示 (非反转) */

    dev_oled_write_cmd(0x8D); /* 充电泵使能 */
    dev_oled_write_cmd(0x14);

    dev_oled_write_cmd(0xAF); /* 开启显示 */
}

/* ================================================================
 * dev_oled_init — OLED 初始化 (SPI 模式)
 *
 * 流程:
 *   1. 初始化 BSP 软件 SPI (GPIO 配置)
 *   2. 硬件复位 (RES 引脚拉低→延时→拉高)
 *   3. 发送 SSD1306 初始化命令序列
 *   4. 清空显存并刷新
 *
 * 注意: SPI OLED 无 I2C 地址概念, 通过 CS 引脚片选替代
 * ================================================================*/
void dev_oled_init(void)
{
    if(s_oled_mutex == NULL)
    {
        s_oled_mutex = xSemaphoreCreateMutex();
    }

    /* 初始化 BSP 软件 SPI (所有 SPI GPIO 配置) */
    bsp_sw_spi_init();

    /* 硬件复位: RES=0 保持 10ms → RES=1 等待稳定 */
    bsp_sw_spi_res_low();
    HAL_Delay(10);
    bsp_sw_spi_res_high();
    HAL_Delay(10);

    /* 发送 SSD1306 标准初始化命令 */
    dev_oled_send_init_sequence();

    /* 清空显存并刷新 */
    dev_oled_clear();
    dev_oled_refresh_gram();
}

void dev_oled_set_contrast(uint8_t val)
{
    oled_spi_lock();
    dev_oled_write_cmd(0x81);
    dev_oled_write_cmd(val);
    oled_spi_unlock();
}

/* ================================================================
 * dev_oled_clear — 清空显存缓冲区 (全部填零)
 * ================================================================*/
void dev_oled_clear(void)
{
    for (uint8_t u8_page = 0U; u8_page < DEV_OLED_PAGES; u8_page++) {
        for (uint8_t u8_col = 0U; u8_col < DEV_OLED_WIDTH; u8_col++) {
            g_u8_oled_gram[u8_page][u8_col] = 0x00U;
        }
    }
}

/* ================================================================
 * dev_oled_refresh_gram — 将显存整体刷新到 OLED
 *
 * 使用页寻址模式逐页刷新:
 *   每页: 设置光标 → 批量传输 128 字节数据
 *   总计 8 次 SPI 事务 (每页 3 条命令 + 128 字节数据合并为 1 次批量写)
 * ================================================================*/
void dev_oled_refresh_gram(void)
{
    oled_spi_lock();
    for (uint8_t u8_page = 0U; u8_page < DEV_OLED_PAGES; u8_page++) {
        dev_oled_set_cursor(u8_page, 0U);
        dev_oled_write_datas(g_u8_oled_gram[u8_page], DEV_OLED_WIDTH);
    }
    oled_spi_unlock();
}

/* ================================================================
 * dev_oled_display_on — 开启 OLED 显示
 * ================================================================*/
void dev_oled_display_on(void)
{
    oled_spi_lock();
    dev_oled_write_cmd(0x8D); /* 充电泵 ON */
    dev_oled_write_cmd(0x14);
    dev_oled_write_cmd(0xAF); /* 显示 ON */
    oled_spi_unlock();
}

/* ================================================================
 * dev_oled_display_off — 关闭 OLED 显示 (休眠)
 * ================================================================*/
void dev_oled_display_off(void)
{
    oled_spi_lock();
    dev_oled_write_cmd(0x8D); /* 充电泵 OFF */
    dev_oled_write_cmd(0x10);
    dev_oled_write_cmd(0xAE); /* 显示 OFF */
    oled_spi_unlock();
}

/* ================================================================
 * dev_oled_draw_point — 画点 / 擦点
 * @param x 水平坐标 0~127
 * @param y 垂直坐标 0~63
 * @param t 1=画点 (置位), 0=擦点 (清零)
 * ================================================================*/
void dev_oled_draw_point(uint8_t x, uint8_t y, uint8_t t)
{
    if ((x >= DEV_OLED_WIDTH) || (y >= DEV_OLED_HEIGHT)) {
        return;
    }

    uint8_t u8_page = y / 8U;
    uint8_t u8_bit  = y % 8U;

    if (t) {
        g_u8_oled_gram[u8_page][x] |=  (uint8_t)(1U << u8_bit);
    } else {
        g_u8_oled_gram[u8_page][x] &= (uint8_t)(~(1U << u8_bit));
    }
}

/* ================================================================
 * dev_oled_draw_line — Bresenham 直线算法
 * ================================================================*/
void dev_oled_draw_line(uint8_t x1, uint8_t y1, uint8_t x2, uint8_t y2)
{
    int16_t dx  = (int16_t)((x2 > x1) ? (x2 - x1) : (x1 - x2));
    int16_t dy  = (int16_t)((y2 > y1) ? (y1 - y2) : (y2 - y1));
    int16_t sx  = (x1 < x2) ? 1 : -1;
    int16_t sy  = (y1 < y2) ? 1 : -1;
    int16_t err = (int16_t)(dx + dy);
    int16_t x   = (int16_t)x1;
    int16_t y   = (int16_t)y1;

    for (;;) {
        dev_oled_draw_point((uint8_t)x, (uint8_t)y, 1U);

        if ((x == (int16_t)x2) && (y == (int16_t)y2)) {
            break;
        }

        int16_t e2 = (int16_t)(err << 1);

        if (e2 >= dy) { err += dy; x += sx; }
        if (e2 <= dx) { err += dx; y += sy; }
    }
}

/* ================================================================
 * dev_oled_draw_rectangle — 画矩形
 * @param fill 0=空心边框, 1=实心填充
 * ================================================================*/
void dev_oled_draw_rectangle(uint8_t x1, uint8_t y1, uint8_t x2, uint8_t y2, uint8_t fill)
{
    if (fill) {
        for (uint8_t y = y1; y <= y2; y++) {
            for (uint8_t x = x1; x <= x2; x++) {
                dev_oled_draw_point(x, y, 1U);
            }
        }
    } else {
        dev_oled_draw_line(x1, y1, x2, y1); /* 上 */
        dev_oled_draw_line(x2, y1, x2, y2); /* 右 */
        dev_oled_draw_line(x2, y2, x1, y2); /* 下 */
        dev_oled_draw_line(x1, y2, x1, y1); /* 左 */
    }
}

/* ================================================================
 * dev_oled_fill — 填充矩形 (便捷封装)
 * ================================================================*/
void dev_oled_fill(uint8_t x1, uint8_t y1, uint8_t x2, uint8_t y2)
{
    dev_oled_draw_rectangle(x1, y1, x2, y2, 1U);
}

/* ================================================================
 * dev_oled_draw_circle — Bresenham 中点画圆算法
 * ================================================================*/
void dev_oled_draw_circle(uint8_t x0, uint8_t y0, uint8_t r)
{
    int16_t sx = 0;
    int16_t sy = (int16_t)r;
    int16_t d  = (int16_t)(1 - (int16_t)r);

    while (sx <= sy) {
        dev_oled_draw_point((uint8_t)(x0 + sx), (uint8_t)(y0 + sy), 1U);
        dev_oled_draw_point((uint8_t)(x0 + sy), (uint8_t)(y0 + sx), 1U);
        dev_oled_draw_point((uint8_t)(x0 - sx), (uint8_t)(y0 + sy), 1U);
        dev_oled_draw_point((uint8_t)(x0 - sy), (uint8_t)(y0 + sx), 1U);
        dev_oled_draw_point((uint8_t)(x0 + sx), (uint8_t)(y0 - sy), 1U);
        dev_oled_draw_point((uint8_t)(x0 + sy), (uint8_t)(y0 - sx), 1U);
        dev_oled_draw_point((uint8_t)(x0 - sx), (uint8_t)(y0 - sy), 1U);
        dev_oled_draw_point((uint8_t)(x0 - sy), (uint8_t)(y0 - sx), 1U);

        if (d < 0) {
            d += (int16_t)(2 * sx + 3);
        } else {
            d += (int16_t)(2 * (sx - sy) + 5);
            sy--;
        }
        sx++;
    }
}

/* ================================================================
 * 内部函数: 求幂 (X^Y)
 * ================================================================*/
static uint32_t dev_oled_pow(uint32_t u32_x, uint32_t u32_y)
{
    uint32_t u32_result = 1UL;
    while (u32_y--) {
        u32_result *= u32_x;
    }
    return u32_result;
}

/* ================================================================
 * 内部函数: 清空显存中字符占用的位区域
 *
 * @param x     像素横坐标
 * @param y     像素纵坐标
 * @param w     字符宽度 (像素)
 * @param h     字符高度 (像素)
 *
 * 逐列计算该列在页中需清零的位区间，仅擦除字符覆盖的部分，
 * 不影响同列同页中其他字符的像素。
 * ================================================================*/
static void dev_oled_clear_char_area(uint8_t x, uint8_t y, uint8_t w, uint8_t h)
{
    uint8_t u8_page_start = y / 8U;
    uint8_t u8_off        = y % 8U;
    uint8_t u8_page_end   = (uint8_t)((y + h - 1U) / 8U);

    for (uint8_t col = 0U; col < w; col++) {
        uint8_t u8_cur_x = x + col;
        if (u8_cur_x >= DEV_OLED_WIDTH) { break; }

        for (uint8_t page = u8_page_start; page <= u8_page_end; page++) {
            if (page >= DEV_OLED_PAGES) { break; }

            uint8_t u8_mask;

            if (page == u8_page_start && page == u8_page_end) {
                u8_mask = (uint8_t)(((1U << h) - 1U) << u8_off);
            } else if (page == u8_page_start) {
                u8_mask = (uint8_t)(0xFFU << u8_off);
            } else if (page == u8_page_end) {
                uint8_t u8_last_bit = (uint8_t)((y + h - 1U) % 8U);
                u8_mask = (uint8_t)((1U << (u8_last_bit + 1U)) - 1U);
            } else {
                u8_mask = 0xFFU;
            }

            g_u8_oled_gram[page][u8_cur_x] &= (uint8_t)(~u8_mask);
        }
    }
}

/* ================================================================
 * dev_oled_show_char — 在显存中绘制单个字符 (防重影)
 *
 * 写入策略:
 *   1. 先调用 dev_oled_clear_char_area 清空字符区域
 *   2. 再将字模数据 OR 写入显存
 *   从而确保用空格 ' ' 替换旧字符时能彻底擦除
 *
 * @param x    像素横坐标 0~127
 * @param y    像素纵坐标 0~63
 * @param chr  ASCII 字符
 * @param size 字号: 12=6×8 (F6x8), 16=8×16 (F8x16)
 * ================================================================*/
void dev_oled_show_char(uint8_t x, uint8_t y, char chr, uint8_t size)
{
    uint8_t u8_idx;

    if ((uint8_t)chr < ' ' || (uint8_t)chr > '~') {
        return;
    }
    u8_idx = (uint8_t)((uint8_t)chr - ' ');

    if (size == 12U) {
        /* ---- F6x8 (6×8) ---- */
        if ((x + 6U > DEV_OLED_WIDTH) || (y + 8U > DEV_OLED_HEIGHT)) {
            return;
        }

        dev_oled_clear_char_area(x, y, 6U, 8U);

        uint8_t u8_page = y / 8U;
        uint8_t u8_off  = y % 8U;

        for (uint8_t col = 0U; col < 6U; col++) {
            uint8_t u8_data = s_u8_f6x8[u8_idx][col];

            g_u8_oled_gram[u8_page][x + col] |= (uint8_t)(u8_data << u8_off);

            if (u8_off > 0U && (u8_page + 1U) < DEV_OLED_PAGES) {
                g_u8_oled_gram[u8_page + 1U][x + col]
                    |= (uint8_t)(u8_data >> (8U - u8_off));
            }
        }
    } else {
        /* ---- F8x16 (8×16) ---- */
        if ((x + 8U > DEV_OLED_WIDTH) || (y + 16U > DEV_OLED_HEIGHT)) {
            return;
        }

        dev_oled_clear_char_area(x, y, 8U, 16U);

        uint8_t u8_page = y / 8U;
        uint8_t u8_off  = y % 8U;

        for (uint8_t col = 0U; col < 8U; col++) {
            uint8_t u8_upper = s_u8_f8x16[u8_idx][col];
            uint8_t u8_lower = s_u8_f8x16[u8_idx][col + 8U];

            if (u8_off == 0U) {
                g_u8_oled_gram[u8_page][x + col] |= u8_upper;
                if ((u8_page + 1U) < DEV_OLED_PAGES) {
                    g_u8_oled_gram[u8_page + 1U][x + col] |= u8_lower;
                }
            } else {
                g_u8_oled_gram[u8_page][x + col] |= (uint8_t)(u8_upper << u8_off);

                if ((u8_page + 1U) < DEV_OLED_PAGES) {
                    g_u8_oled_gram[u8_page + 1U][x + col]
                        |= (uint8_t)((u8_upper >> (8U - u8_off))
                                  |  (u8_lower << u8_off));
                }

                if ((u8_page + 2U) < DEV_OLED_PAGES) {
                    g_u8_oled_gram[u8_page + 2U][x + col]
                        |= (uint8_t)(u8_lower >> (8U - u8_off));
                }
            }
        }
    }
}

/* ================================================================
 * dev_oled_show_string — 显示字符串 (默认 8×16 字模)
 * ================================================================*/
void dev_oled_show_string(uint8_t x, uint8_t y, const char *p_str)
{
    dev_oled_show_string_size(x, y, p_str, 16U);
}

/* ================================================================
 * dev_oled_show_string_size — 显示字符串 (可选字号)
 * ================================================================*/
void dev_oled_show_string_size(uint8_t x, uint8_t y, const char *p_str, uint8_t size)
{
    uint8_t u8_step;

    if (p_str == ((void *)0)) {
        return;
    }

    u8_step = (size == 12U) ? 6U : 8U;

    uint8_t u8_x = x;
    for (uint8_t i = 0U; p_str[i] != '\0'; i++) {
        dev_oled_show_char(u8_x, y, p_str[i], size);
        u8_x += u8_step;

        if (u8_x >= DEV_OLED_WIDTH) {
            break;
        }
    }
}

/* ================================================================
 * dev_oled_show_num — 显示格式化数字
 * ================================================================*/
void dev_oled_show_num(uint8_t x, uint8_t y, uint32_t num, uint8_t len, uint8_t size)
{
    uint8_t u8_step = (size == 12U) ? 6U : 8U;
    uint8_t u8_x    = x;

    for (uint8_t i = 0U; i < len; i++) {
        uint8_t u8_digit = (uint8_t)(
            (num / dev_oled_pow(10UL, (uint32_t)(len - i - 1U))) % 10UL);
        dev_oled_show_char(u8_x, y, (char)('0' + u8_digit), size);
        u8_x += u8_step;

        if (u8_x >= DEV_OLED_WIDTH) {
            break;
        }
    }
}
